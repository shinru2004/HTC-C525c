## drivers/i2c/chips/Kconfig
```kconfig
#
# Miscellaneous I2C chip drivers configuration
#
# *** DEPRECATED! Do not add new entries! See Makefile ***
#

menu "Miscellaneous I2C Chip support"

config SENSORS_NFC_PN544
	tristate "PN544 NFC sensor support"
	depends on I2C=y
	help
	  PN544 NFC Driver implemented.

config SENSORS_AKM8975
        tristate "AKM8973 Compass Driver"
        depends on I2C
        help
         AKM8975 Compass Driver implemented by HTC.

config SENSORS_AKM8975_PANA_GYRO
        tristate "AKM8973 Compass Driver for Pana Gyro"
        depends on I2C
        help
         AKM8975 Compass Driver implemented by HTC.

config SENSORS_BMA250
	tristate "BMA250 acceleration sensor support"
	depends on I2C=y
	help
	  BMA250 G-sensor Driver implemented by HTC.

config INPUT_CAPELLA_CM3629
        tristate "CM3629 proximity and light sensor"
        help
          Say Y here to enable the CM3629 Short Distance Proximity
          Sensor with Ambient Light Sensor.

endmenu
```
